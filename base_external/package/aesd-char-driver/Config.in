## base_external/package/aesd-char-driver/Config.in
```kconfig
config BR2_PACKAGE_AESD_CHAR_DRIVER
	bool "aesd-char-driver"
	depends on BR2_LINUX_KERNEL
	help
	  Includes char device resources for assignment 8
```

## base_external/package/aesdchar-driver/Config.in
```kconfig
config BR2_PACKAGE_AESDCHAR_DRIVER
	bool "aesdchar-driver"
	depends on BR2_LINUX_KERNEL
	help
	  Includes char device resources for assignment 8
```

## base_external/package/ldd/Config.in
```kconfig
config BR2_PACKAGE_LDD
	bool "ldd"
	depends on BR2_LINUX_KERNEL
	help
	  Includes resources for assignment 7
```
